/*******************************************************************
    Using a 64 * 32 RGB Matrix to displays the Instructables
    Mascot!
 *                                                                 *
    Written by Brian Lough
    https://www.youtube.com/channel/UCezJOfu7OtqGzd5xrP3q6WA
 *******************************************************************/

// ----------------------------
// Standard Libraries - Already Installed if you have ESP8266 set up
// ----------------------------
#include <Ticker.h>
#include <ESP8266WiFi.h>
#include <WiFiClientSecure.h>
#include <stdio.h>
#include <stdlib.h>



// ----------------------------
// Additional Libraries - each one of these will need to be installed.
// ----------------------------


#include <PxMatrix.h>
// The library for controlling the LED Matrix
// Needs to be manually downloaded and installed
// https://github.com/2dom/PxMatrix

char ssid[] = "The LAN Before Time";       // your network SSID (name)
char password[] = "Littlefootpowersyourcar";  // your network key


Ticker display_ticker;

WiFiClientSecure client;

// Pins for LED MATRIX
#define P_LAT 16
#define P_A 5
#define P_B 4
#define P_C 15
#define P_OE 2
#define P_D 12
#define P_E 0

// PxMATRIX display(32,16,P_LAT, P_OE,P_A,P_B,P_C);
// PxMATRIX display(64,32,P_LAT, P_OE,P_A,P_B,P_C,P_D);
PxMATRIX display(64, 32, P_LAT, P_OE, P_A, P_B, P_C, P_D, P_E);

// Some standard colors
uint16_t myRED = display.color565(255, 0, 0);
uint16_t myGREEN = display.color565(0, 255, 0);
uint16_t myBLUE = display.color565(0, 0, 255);
uint16_t myWHITE = display.color565(255, 255, 255);
uint16_t myYELLOW = display.color565(255, 255, 0);
uint16_t myCYAN = display.color565(0, 255, 255);
uint16_t myMAGENTA = display.color565(255, 0, 255);
uint16_t myBLACK = display.color565(0, 0, 0);

uint16 myCOLORS[8] = {myRED, myGREEN, myBLUE, myWHITE, myYELLOW, myCYAN, myMAGENTA, myBLACK};

// Converted using the following site: http://www.rinkydinkelectronics.com/t_imageconverter565.php
uint16_t static image[] = {
0xFFFF, 0xFFFF, 0xFFFF, 0xFFFF, 0xFFFF, 0xFFFF, 0xFFFF, 0xFFFF, 0xFFFF, 0xFFFF, 0xFFFF, 0xFFFF, 0xFFFF, 0xFFFF, 0xFFFF, 0xFFFF,   // 0x0010 (16) pixels
0xFFFF, 0xFFFF, 0xFFFF, 0xFFFF, 0xFFFF, 0xFFFF, 0xFFFF, 0xFFFF, 0xFFFF, 0xFFFF, 0xFFFF, 0xFFFF, 0xFFFF, 0xFFFF, 0xFFFF, 0xFFFF,   // 0x0020 (32) pixels
0xFFFF, 0xFFFF, 0xFFFF, 0xFFFF, 0xFFFF, 0xFFFF, 0xFFFF, 0xFFFF, 0xFFFF, 0xFFFF, 0xFFFF, 0xFFFF, 0xFFFF, 0xFFFF, 0xFFFF, 0xFFFF,   // 0x0030 (48) pixels
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0xFFFF, 0xFFFF, 0xFFFF, 0xFFFF, 0xFFFF, 0xFFFF, 0xFFFF, 0xFFFF, 0xFFFF, 0xFFFF, 0xFFFF, 0xFFFF, 0xFFFF, 0xFFFF, 0xFFFF, 0xFFFF,   // 0x0800 (2048) pixels
};




// ISR for display refresh
void display_updater()
{

  display.display(70);

}
void display_update_enable(bool is_enable)
{

#ifdef ESP8266
  if (is_enable)
    display_ticker.attach(0.002, display_updater);
  else
    display_ticker.detach();
#endif

#ifdef ESP32
  if (is_enable)
  {
    timer = timerBegin(0, 80, true);
    timerAttachInterrupt(timer, &display_updater, true);
    timerAlarmWrite(timer, 2000, true);
    timerAlarmEnable(timer);
  }
  else
  {
    timerDetachInterrupt(timer);
    timerAlarmDisable(timer);
  }
#endif
}

void pixel_time_test(uint8_t draw_time)
{
  int num;
   
  Serial.print("Pixel draw latency in us: ");
  unsigned long start_timer=micros();
  display.drawPixel(1,1,0);
  unsigned long delta_timer=micros()-start_timer;
  Serial.println(delta_timer);

  Serial.print("Display update latency in us: ");
  start_timer=micros();
  display.display(draw_time);
  delta_timer=micros()-start_timer;
  Serial.println(delta_timer);


  display.setBrightness(0);
  display.clearDisplay();

  display.setTextSize(1);


/////////////////////////////////
//////// SCROLLING TEXT /////////
/////////////////////////////////

  String whee = "WHEEE";
  while(1){
    for(int i = 0; i < 63; i++){
      whee = "WHEEE";
      yield();
      if(i >= 35 && i <= 41){
        whee = "WHEEE";
      }
      if(i >= 41 && i < 47){
        whee = "WHEE";
      }
      if(i >= 53 && i < 59){
        whee = "WHE";
      }
      if(i >= 65 && i < 71){
        whee = "WH";
      }
      if(i >= 71){
        whee = "W";
      }
      
      display.setTextColor(myRED);
      display.setCursor(i,0);
      display.print(whee);
      yield();
      display.setTextColor(myGREEN);  
      display.setCursor((i + 8) % 64,8);
      display.print(whee);
      yield();
      display.setTextColor(myBLUE);  
      display.setCursor((i + 16) % 64,16);
      display.print(whee);
      yield();
      display.setTextColor(myMAGENTA);  
      display.setCursor((i + 24) % 64,24);
      display.print(whee);
      yield();
      delay(10);
      display.clearDisplay();   
    }
  }

  yield();
  delay(5000);


 

  display_update_enable(false);
}

void pixel_time_test2(uint8_t draw_time)
{
  display.clearDisplay();
  Serial.print("Pixel draw latency in us: ");
  unsigned long start_timer=micros();
  display.drawPixel(1,1,0);
  unsigned long delta_timer=micros()-start_timer;
  Serial.println(delta_timer);

  Serial.print("Display update latency in us: ");
  start_timer=micros();
  display.display(draw_time);
  delta_timer=micros()-start_timer;
  Serial.println(delta_timer);


  display.setBrightness(255);
  display.setTextColor(myCYAN);
  display.setTextSize(1);
  display.setCursor(2,0);
  display.print("Hooray PxMatrix!");
  display_update_enable(true);

  yield();
  delay(2000);
}
void setup() {
//  
//  display.begin(16);
//  display.clearDisplay();
//  display.setTextColor(myCYAN);
//  display.setTextSize(1);
//  display.setCursor(2, 0);
//  display.print("Connecting");
//  display.setTextColor(myMAGENTA);
//  display.setCursor(2, 8);
//  display.print("to the");
//  display.setTextColor(myGREEN);
//  display.setCursor(2, 16);
//  display.print("WiFi!");
//  WiFi.mode(WIFI_STA);
//  WiFi.disconnect();
//  Serial.print("Connecting Wifi: ");
//  Serial.println(ssid);
//  WiFi.begin(ssid, password);
//  while (WiFi.status() != WL_CONNECTED) {
//    Serial.print(".");
//    delay(500);
//  }
//  Serial.println("");
//  Serial.println("WiFi connected");
//  Serial.println("IP address: ");
//  IPAddress ip = WiFi.localIP();
//  Serial.println(ip);

  
  
  display.begin(16);
  display.clearDisplay();
  Serial.print("Pixel draw latency in us: ");
  unsigned long start_timer = micros();
  display.drawPixel(1, 1, 0);
  unsigned long delta_timer = micros() - start_timer;
  Serial.println(delta_timer);

  Serial.print("Display update latency in us: ");
  start_timer = micros();
  display.display(0);
  delta_timer = micros() - start_timer;
  Serial.println(delta_timer);

  display_ticker.attach(0.002, display_updater);
  yield();
  display.clearDisplay();
  //drawImage(0, 0);
  delay(500);
//
//  pixel_time_test(100);
    loop();
}

void drawImage(int x, int y)
{
  int imageHeight = 32;
  int imageWidth = 64;
  int counter = 0;
  for (int yy = 0; yy < imageHeight; yy++)
  {
    for (int xx = 0; xx < imageWidth; xx++)
    {
      display.drawPixel(xx + x , yy + y, image[counter]);
      counter++;
    }
  }
}


void loop() {
  pixel_time_test(100);
    
}
